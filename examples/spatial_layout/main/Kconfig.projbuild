## examples/spatial_layout/main/Kconfig.projbuild
```kconfig
menu "Spatial layout demo"
    config XS_WIFI_SSID
        string "Existing Wi-Fi SSID"
        default ""
    config XS_WIFI_PASSWORD
        string "Existing Wi-Fi password"
        default ""
    config XS_MAX_BOARDS
        int "Maximum discovered boards (including this board)"
        range 4 65535
        default 16
        help
            Allocations grow quadratically. Choose a capacity that fits RAM;
            65535 is the wire-format limit, not an achievable ESP32 node count.
    config XS_GROUP
        hex "Discovery group (same on every board)"
        default 0x584d4153
endmenu
```

## examples/spatial_layout/sdkconfig.defaults
```kconfig
CONFIG_IDF_TARGET="esp32s3"
CONFIG_ESP_WIFI_FTM_ENABLE=y
CONFIG_ESP_WIFI_FTM_INITIATOR_SUPPORT=y
CONFIG_ESP_WIFI_FTM_RESPONDER_SUPPORT=y
CONFIG_ESP_MAIN_TASK_STACK_SIZE=4096
```
